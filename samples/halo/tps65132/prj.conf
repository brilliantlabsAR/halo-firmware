## CMakeLists.txt
```
# SPDX-License-Identifier: Apache-2.0

cmake_minimum_required(VERSION 3.20.0)
find_package(Zephyr REQUIRED HINTS $ENV{ZEPHYR_BASE})
project(tps65132)

FILE(GLOB app_sources src/*.c)
target_sources(app PRIVATE ${app_sources})
```

## sample.yaml
```
sample:
  name: TPS65132 Dual Output LCD Bias Regulator
  description: >
    Control TPS65132 dual output LCD bias power supply with VPOS and VENG
    voltage rails using the Zephyr regulator API.

tests:
  sample.halo.tps65132:
    harness: console
    tags:
      - i2c
      - regulator
      - display
      - power
    platform_allow:
      - halo
    integration_platforms:
      - halo
    depends_on:
      - i2c
      - regulator
    filter: dt_nodelabel_enabled("tps65132")
    harness_config:
      type: multi_line
      regex:
        - "Regulator Control Demo"
        - "VPOS enabled"
        - "VENG enabled"
        - "VPOS disabled"
        - "VENG disabled"
```

## prj.conf
```kconfig
CONFIG_STDOUT_CONSOLE=y
CONFIG_I2C=y
CONFIG_I2C_DW=y
CONFIG_SENSOR=y
CONFIG_CBPRINTF_FP_SUPPORT=y
```

## src/main.c
```c
#include <zephyr/kernel.h>
#include <zephyr/drivers/regulator.h>
#include <zephyr/sys/printk.h>

int main(void)
{
	printk("Regulator Control Demo\n");

	const struct device *vpos = DEVICE_DT_GET(DT_NODELABEL(vpos));
	const struct device *veng = DEVICE_DT_GET(DT_NODELABEL(veng));

	if (!device_is_ready(vpos) || !device_is_ready(veng)) {
		printk("Regulators not ready!\n");
		return 0;
	}

	while (1) {
		if (regulator_enable(vpos) != 0) {
			printk("Failed to enable VPOS!\n");
		} else {
			printk("VPOS enabled\n");
		}

		if (regulator_enable(veng) != 0) {
			printk("Failed to enable VENG!\n");
		} else {
			printk("VENG enabled\n");
		}

		k_sleep(K_SECONDS(10));
		regulator_disable(vpos);
		printk("VPOS disabled\n");
		regulator_disable(veng);
		printk("VENG disabled\n");

		k_sleep(K_SECONDS(10));
	}
	return 0;
}
```
