## sample.yaml
```
sample:
  name: Ship Mode Sample
  description: Shutdown device into ultra-low power ship mode

tests:
  sample.halo.shipmode:
    harness: console
    tags:
      - gpio
      - power
      - shipmode
    platform_allow:
      - halo
    integration_platforms:
      - halo
    depends_on:
      - gpio
    filter: dt_alias_exists("shutdown")
    harness_config:
      type: multi_line
      regex:
        - "Ship Mode Sample"
        - "Shutdown in"
        - "Shutting down now"
```

## prj.conf
```kconfig
# Ship Mode Sample Configuration

# Enable ship mode driver
CONFIG_SM_GPIO=y

# Enable logging
CONFIG_LOG=y
CONFIG_LOG_MODE_IMMEDIATE=y

# Power management
CONFIG_PM=y
CONFIG_PM_DEVICE=y 
```

## src/main.c
```c
/**
 * @file main.c
 * @brief Ship Mode Sample
 *
 * Copyright (C) 2025 Brilliant Labs
 * SPDX-License-Identifier: Apache-2.0
 */

#include <zephyr/kernel.h>
#include <zephyr/device.h>
#include <zephyr/drivers/sm/sm.h>

#define COUNTDOWN_SECONDS  5

int main(void)
{
	const struct device *sm = DEVICE_DT_GET(DT_ALIAS(shutdown));

	printk("\n=== Ship Mode Sample ===\n\n");

	if (!device_is_ready(sm)) {
		printk("ERROR: Ship mode device not ready!\n");
		return -1;
	}

	printk("WARNING: Device will shutdown in %d seconds\n", COUNTDOWN_SECONDS);
	printk("Hardware reset required to wake up!\n\n");

	for (int i = COUNTDOWN_SECONDS; i > 0; i--) {
		printk("Shutdown in %d...\n", i);
		k_sleep(K_SECONDS(1));
	}

	printk("\nShutting down now!\n");
	
	shutdown(sm);

	/* Should not reach here if ship mode works correctly */
	k_sleep(K_SECONDS(1));
	printk("WARNING: Still running! Check hardware.\n");

	while (1) {
		k_sleep(K_FOREVER);
	}
	
	return 0;
}
```
