## CMakeLists.txt
```
cmake_minimum_required(VERSION 3.20.0)
find_package(Zephyr REQUIRED HINTS $ENV{ZEPHYR_BASE})
project(alif_inference)

target_sources(app PRIVATE
    src/mfcc/PlatformMath.cc
    src/mfcc/KwsProcessing.cc
    src/mfcc/Mfcc.cc
    src/kws_micronet_m_vela_H128.tflite.cc
    src/main.cpp
    src/KWSModel.cpp
    src/LiveMicInput.cpp
)
```

## Kconfig
```
# Copyright (C) 2025 Alif Semiconductor - All Rights Reserved.
# Use, distribution and modification of this code is permitted under the
# terms stated in the Alif Semiconductor Software License Agreement
#
# You should have received a copy of the Alif Semiconductor Software
# License Agreement with this file. If not, please write to:
# contact@alifsemi.com, or visit: https://alifsemi.com/license


config ACTIVATION_BUF_SECTION
	string "Linker section where activation buffer (tensor arena) is placed"
	default ".bss.activation_buf"

config ACTIVATION_BUF_SZ
	hex "Tensor arena size"
	default 0x20000

config MODEL_IN_EXT_FLASH
	bool "Put ML model to external flash"
	select FLASH
	select ALIF_OSPI_FLASH_XIP
	help
		Initialize OSPI controller to XIP mode. Initialize the onboard flash device. Link ML model data to external flash address space.
		In addition to normal zephyr.bin output, ospi1.bin is generated. When enabled, the model memory section is set automatically (See BufAttributes.h)

config MODEL_SECTION
	string "Linker section where ML model is placed"
	depends on !MODEL_IN_EXT_FLASH
	default ".rodata.tflm_model"

config I2S_SAMPLE_RATE
	int "I2S sampling rate"
	default 16000

config I2S_CHANNELS
	int "Number of I2S channels"
	default 2

config I2S_SAMPLES
	int "Number of samples per slab buffer"
	default 400

config I2S_NUM_BUFFERS
	int "Number of I2S slab buffers to allocate"
	default 2

config I2S_GAIN
	int "Fixed linear again applied to I2S samples (e.g 10 = 20dB gain)"
	default 20

source "Kconfig.zephyr"
```

## prj.conf
```kconfig
CONFIG_CPP=y
CONFIG_STD_CPP17=y
CONFIG_TENSORFLOW_LITE_MICRO=y
CONFIG_ARM_ETHOS_U=y
CONFIG_HEAP_MEM_POOL_SIZE=16384
CONFIG_LOG=y
CONFIG_LOG_MODE_IMMEDIATE=y
CONFIG_BUILD_NO_GAP_FILL=y
CONFIG_REQUIRES_FULL_LIBC=y
CONFIG_NEWLIB_LIBC=y
CONFIG_REQUIRES_FULL_LIBCPP=y
CONFIG_NEWLIB_LIBC_MIN_REQUIRED_HEAP_SIZE=8192
CONFIG_I2S=y
CONFIG_CMSIS_DSP=y
CONFIG_CMSIS_DSP_TRANSFORM=y
CONFIG_CMSIS_DSP_FASTMATH=y
CONFIG_CMSIS_DSP_COMPLEXMATH=y
CONFIG_MAIN_STACK_SIZE=4096
CONFIG_CBPRINTF_FP_SUPPORT=y
```

## boards/alif_e1c_dk_rtss_he.overlay
```dts
/* Copyright (C) 2025 Alif Semiconductor - All Rights Reserved.
 * Use, distribution and modification of this code is permitted under the
 * terms stated in the Alif Semiconductor Software License Agreement
 *
 * You should have received a copy of the Alif Semiconductor Software
 * License Agreement with this file. If not, please write to:
 * contact@alifsemi.com, or visit: https: //alifsemi.com/license
 *
 */

/ {
	aliases {
		i2s-mic = &i2s2;
	};
};

/* i2s1 default pinmux conflicts with ospi0 */
&i2s1 {
	status = "disabled";
};

&ospi0 {
	bus-speed = <80000000>;
	status = "okay";
};
```

## boards/alif_e3_dk_rtss_he.overlay
```dts
/* Copyright (C) 2025 Alif Semiconductor - All Rights Reserved.
 * Use, distribution and modification of this code is permitted under the
 * terms stated in the Alif Semiconductor Software License Agreement
 *
 * You should have received a copy of the Alif Semiconductor Software
 * License Agreement with this file. If not, please write to:
 * contact@alifsemi.com, or visit: https: //alifsemi.com/license
 *
 */

/ {
	aliases {
		i2s-mic = &i2s3;
	};
};

&ospi1 {
	bus-speed = <100000000>;
	status = "okay";
};
```

## src/main.cpp
```c
#include <zephyr/kernel.h>
#include <zephyr/logging/log.h>

#include <algorithm>
#include <limits>
#include <vector>

#include "KWSModel.h"
#include "LiveMicInput.h"
#include "ethosu/InferenceRunner.h"

LOG_MODULE_REGISTER(main);

template <typename T>
class PrintHighestConfidence
{
public:
	void ProcessOutput(const T &result)
	{
		const auto it =
			std::max_element(result.confidences.begin(), result.confidences.end());
		const auto highest_idx = std::distance(result.confidences.begin(), it);

		LOG_INF("%s: %f", T::Result::GetLabelName(highest_idx),
			static_cast<double>(result.confidences[highest_idx]));
	}
};

int main()
{
	InferenceRunner<KWSModel, LiveMicInput, PrintHighestConfidence<KWSModel::Result>> runner;

	runner.Start();

	while (true) {
		k_usleep(1000);
	}

	return 0;
}
```

## src/BufAttributes.hpp
```c
/*
 * SPDX-FileCopyrightText: Copyright 2021 Arm Limited and/or its affiliates
 * <open-source-office@arm.com> SPDX-License-Identifier: Apache-2.0
 *
 * Licensed under the Apache License, Version 2.0 (the "License");
 * you may not use this file except in compliance with the License.
 * You may obtain a copy of the License at
 *
 *     http://www.apache.org/licenses/LICENSE-2.0
 *
 * Unless required by applicable law or agreed to in writing, software
 * distributed under the License is distributed on an "AS IS" BASIS,
 * WITHOUT WARRANTIES OR CONDITIONS OF ANY KIND, either express or implied.
 * See the License for the specific language governing permissions and
 * limitations under the License.
 */

#ifndef BUF_ATTRIBUTES_HPP
#define BUF_ATTRIBUTES_HPP

#include <zephyr/devicetree.h>

#define BYTE_ALIGNMENT         16
#define ALIGNMENT_REQ          aligned(BYTE_ALIGNMENT)
#define ACTIVATION_BUF_SECTION section(CONFIG_ACTIVATION_BUF_SECTION)

#if CONFIG_MODEL_IN_EXT_FLASH
#define MODEL_SECTION                                                                              \
	section(".alif_extflash_" DT_PROP(DT_NODELABEL(ext_flash_xip), zephyr_memory_region))
#else
#define MODEL_SECTION section(CONFIG_MODEL_SECTION)
#endif

#define MAKE_ATTRIBUTE(x)        __attribute__((ALIGNMENT_REQ, x))
#define MODEL_TFLITE_ATTRIBUTE   MAKE_ATTRIBUTE(MODEL_SECTION)
#define ACTIVATION_BUF_ATTRIBUTE MAKE_ATTRIBUTE(ACTIVATION_BUF_SECTION)
#define LABELS_ATTRIBUTE

#endif /* BUF_ATTRIBUTES_HPP */
```

## src/KWSModel.cpp
```c
#include <zephyr/logging/log.h>

#include "KWSModel.h"

#include "mfcc/PlatformMath.hpp"
#include "mfcc/MicroNetKwsModel.hpp"
#include "BufAttributes.hpp"

LOG_MODULE_REGISTER(KWSModel);

// By having these as global state prevents us from having multiple instances of KWSModel
// these can be move into the class, but then these must be allocated dynamically
static uint8_t tensorArena[CONFIG_ACTIVATION_BUF_SZ] ACTIVATION_BUF_ATTRIBUTE;

// Full 1 second sample buffer
static int16_t audio_inf[CONFIG_I2S_SAMPLE_RATE];

static const char *labelsVec[] LABELS_ATTRIBUTE = {
	"down",  "go",   "left", "no",  "off",       "on",
	"right", "stop", "up",   "yes", "_silence_", "_unknown_",
};

namespace arm::app::kws
{
extern uint8_t *GetModelPointer();
extern const int g_FrameLength;
extern const int g_FrameStride;
} // namespace arm::app::kws

const char *KWSModel::Result::GetLabelName(size_t index)
{
	return labelsVec[index];
}

bool KWSModel::Init()
{
	m_resolver.AddEthosU();

	m_pInterpreter = std::make_unique<tflite::MicroInterpreter>(
		tflite::GetModel(arm::app::kws::GetModelPointer()), m_resolver, tensorArena,
		CONFIG_ACTIVATION_BUF_SZ);

	const auto rc = m_pInterpreter->AllocateTensors();
	if (rc != kTfLiteOk) {
		LOG_ERR("AllocateTensors failed: %i", rc);
		return false;
	}

	auto *inputTensor = m_pInterpreter->input(0);
	size_t numMfccFeatures =
		inputTensor->dims->data[arm::app::MicroNetKwsModel::ms_inputColsIdx];
	size_t numMfccFrames = inputTensor->dims->data[arm::app::MicroNetKwsModel::ms_inputRowsIdx];
	int mfccFrameLength = arm::app::kws::g_FrameLength;
	int mfccFrameStride = arm::app::kws::g_FrameStride;

	m_preProcess = std::make_unique<arm::app::KwsPreProcess>(
		inputTensor, numMfccFeatures, numMfccFrames, mfccFrameLength, mfccFrameStride);

	return true;
}

bool KWSModel::PreProcess()
{
	if (!m_preProcess->DoPreProcess(audio_inf, m_index)) {
		LOG_ERR("DoPreProcess failed");
		return false;
	}

	++m_index;

	// move buffer down by one stride, clearing space at the end for the next stride
	std::copy(audio_inf + (CONFIG_I2S_SAMPLE_RATE / 2), audio_inf + CONFIG_I2S_SAMPLE_RATE,
		  audio_inf);

	return true;
}

bool KWSModel::RunInference()
{
	const auto rc = m_pInterpreter->Invoke();
	if (rc != kTfLiteOk) {
		LOG_ERR("Invoke failed: %i", rc);
		return false;
	}

	return true;
}

bool KWSModel::PostProcess()
{
	m_output.confidences.clear();

	const auto *tensor = m_pInterpreter->output(0);

	// int8 dequantize, does not work if per-axis quantization is used.
	for (size_t i = 0; i < tensor->bytes; i++) {
		float value = tensor->params.scale * (static_cast<float>(tensor->data.int8[i]) -
						      tensor->params.zero_point);
		m_output.confidences.push_back(value);
	}

	arm::app::math::MathUtils::SoftmaxF32(m_output.confidences);

	return true;
}

void *KWSModel::GetInputBuffer()
{
	// Fill input data to last stride in the buffer
	return &audio_inf[CONFIG_I2S_SAMPLE_RATE / 2];
}

KWSModel::Result KWSModel::GetResult()
{
	return m_output;
}
```

## src/KWSModel.h
```c
#ifndef KWSMODEL_H
#define KWSMODEL_H

#include <memory>
#include <vector>

#include <tensorflow/lite/micro/micro_interpreter.h>
#include <tensorflow/lite/micro/micro_mutable_op_resolver.h>

#include "mfcc/KwsProcessing.hpp"

class KWSModel
{
public:
	class Result
	{
		public:
		std::vector<float> confidences;
		static const char *GetLabelName(size_t index);
	};

	/* Input buffer size in bytes (0.5 second of audio samples) */
	static constexpr size_t InputSize = (CONFIG_I2S_SAMPLE_RATE / 2) * sizeof(int16_t);

	bool Init(void);
	bool PreProcess(void);
	bool RunInference(void);
	bool PostProcess(void);
	void *GetInputBuffer(void);
	Result GetResult(void);

private:
	std::unique_ptr<tflite::MicroInterpreter> m_pInterpreter;
	std::unique_ptr<arm::app::KwsPreProcess> m_preProcess;
	tflite::MicroMutableOpResolver<1> m_resolver;
	int m_index = 0;
	Result m_output;
};

#endif
```

## src/LiveMicInput.cpp
```c
#include <zephyr/logging/log.h>
#include <zephyr/device.h>
#include <zephyr/kernel.h>
#include <zephyr/drivers/i2s.h>

#include "LiveMicInput.h"

LOG_MODULE_REGISTER(LiveMicInput);

BUILD_ASSERT(LiveMicInput::OutputSize % CONFIG_I2S_SAMPLES == 0,
	     "LiveMicInput::OutputSize must be a multiple of CONFIG_I2S_SAMPLES");
BUILD_ASSERT(CONFIG_I2S_SAMPLES % 4 == 0, "CONFIG_I2S_SAMPLES must be a multiple of 4");

#define I2S_DEVICE      DT_ALIAS(i2s_mic)
#define I2S_SAMPLE_SIZE sizeof(int16_t)
#define I2S_WORD_SIZE   (I2S_SAMPLE_SIZE * 8)
#define I2S_SAMPLE_RATE CONFIG_I2S_SAMPLE_RATE
#define I2S_CHANNELS    CONFIG_I2S_CHANNELS
#define I2S_SAMPLES     CONFIG_I2S_SAMPLES
#define I2S_NUM_BUFFERS CONFIG_I2S_NUM_BUFFERS
#define I2S_BUFFER_SIZE (I2S_CHANNELS * I2S_SAMPLES * I2S_SAMPLE_SIZE)
#define I2S_GAIN        CONFIG_I2S_GAIN

K_MEM_SLAB_DEFINE_STATIC(mem_slab, I2S_BUFFER_SIZE, I2S_NUM_BUFFERS, 4);
static const struct device *i2s_mic = DEVICE_DT_GET(I2S_DEVICE);

static int i2s_mix_mono_output(int16_t *in, size_t in_size, int16_t *out, size_t out_size)
{
	size_t num_samples = in_size / 2;

	if (out_size < num_samples) {
		return -EINVAL;
	}

	for (size_t i = 0; i < num_samples; ++i) {
		int16_t left_channel = in[2 * i];
		int16_t right_channel = in[2 * i + 1];

		out[i] = static_cast<int16_t>((left_channel + right_channel) / 2);
		out[i] *= I2S_GAIN;
	}

	return 0;
}

bool LiveMicInput::Start()
{
	if (!device_is_ready(i2s_mic)) {
		LOG_ERR("i2s_mic is not ready");
		return false;
	}

	const struct i2s_config config = {
		.word_size = I2S_WORD_SIZE,
		.channels = I2S_CHANNELS,
		.format = I2S_FMT_DATA_FORMAT_I2S,
		.options = I2S_OPT_FRAME_CLK_MASTER | I2S_OPT_BIT_CLK_MASTER,
		.frame_clk_freq = static_cast<uint32_t>(I2S_SAMPLE_RATE),
		.mem_slab = &mem_slab,
		.block_size = I2S_BUFFER_SIZE,
		.timeout = SYS_FOREVER_MS,
	};

	int rc = i2s_configure(i2s_mic, I2S_DIR_RX, &config);

	if (rc < 0) {
		LOG_ERR("i2s_configure failed: %i", rc);
		return false;
	}

	rc = i2s_trigger(i2s_mic, I2S_DIR_RX, I2S_TRIGGER_START);
	if (rc != 0) {
		LOG_ERR("I2S_TRIGGER_START failed: %i", rc);
		return false;
	}

	return true;
}

bool LiveMicInput::Stop()
{
	int rc = i2s_trigger(i2s_mic, I2S_DIR_RX, I2S_TRIGGER_DROP);
	if (rc != 0) {
		LOG_ERR("I2S_TRIGGER_DROP failed: %i", rc);
		return false;
	}

	return true;
}

bool LiveMicInput::GetInputData(void *buffer)
{
	void *slab = NULL;
	size_t slab_size = 0;
	size_t offset = 0;

	int16_t *output_buffer = static_cast<int16_t *>(buffer);

	while (OutputSize > offset) {
		int rc = i2s_read(i2s_mic, &slab, &slab_size);
		if (rc != 0) {
			LOG_ERR("i2s read failed: %i", rc);
			return false;
		}

		int stereo_samples = slab_size / I2S_SAMPLE_SIZE;

		rc = i2s_mix_mono_output(static_cast<int16_t *>(slab), stereo_samples,
					 output_buffer + offset / sizeof(int16_t),
					 OutputSize - offset);

		if (rc < 0) {
			k_mem_slab_free(&mem_slab, slab);
			LOG_ERR("i2s_mix_mono_output failed: %i", rc);
			return false;
		}

		k_mem_slab_free(&mem_slab, slab);
		offset += (stereo_samples / 2) * sizeof(int16_t); // In bytes
	}

	return true;
}
```

## src/LiveMicInput.h
```c
#ifndef LIVEMICINPUT_H
#define LIVEMICINPUT_H

#include <cstddef>

class LiveMicInput
{
public:
	/* 0.5 sec stride (in bytes) */
	static constexpr size_t OutputSize = (CONFIG_I2S_SAMPLE_RATE / 2) * sizeof(int16_t);

	bool Start();
	bool Stop();
	bool GetInputData(void *buffer);
};

#endif /* LIVEMICINPUT_H */
```
