## CMakeLists.txt
```
# Copyright (C) 2024 Alif Semiconductor
# SPDX-License-Identifier: Apache-2.0

cmake_minimum_required(VERSION 3.20.0)
find_package(Zephyr REQUIRED HINTS $ENV{ZEPHYR_BASE})
project(dac)

target_sources(app PRIVATE src/main.c)
```

## sample.yaml
```
sample:
	name: Demo for DAC driver
tests:
	sample.drivers.dac:
		tags: drivers dac
		depends_on: dac
```

## prj.conf
```kconfig
CONFIG_DAC=y
```

## boards/alif_b1_dk_rtss_he_a5.overlay
```dts
/* Copyright (C) 2025 Alif Semiconductor - All Rights Reserved.
 * Use, distribution and modification of this code is permitted under the
 * terms stated in the Alif Semiconductor Software License Agreement
 *
 * You should have received a copy of the Alif Semiconductor Software
 * License Agreement with this file. If not, please write to:
 * contact@alifsemi.com, or visit: https://alifsemi.com/license
 *
 */


/ {
	aliases {
		dac = &dac0;
	};
};

&dac0{
	status = "okay";
};
```

## boards/alif_e1c_dk_rtss_he.overlay
```dts
/* Copyright (C) 2024 Alif Semiconductor - All Rights Reserved.
 * Use, distribution and modification of this code is permitted under the
 * terms stated in the Alif Semiconductor Software License Agreement
 *
 * You should have received a copy of the Alif Semiconductor Software
 * License Agreement with this file. If not, please write to:
 * contact@alifsemi.com, or visit: https://alifsemi.com/license
 *
 */


/ {
	aliases {
		dac = &dac0;
	};
};

&dac0{
	status = "okay";
};
```

## boards/alif_e7_dk_rtss_he.overlay
```dts
/* Copyright (C) 2024 Alif Semiconductor - All Rights Reserved.
 * Use, distribution and modification of this code is permitted under the
 * terms stated in the Alif Semiconductor Software License Agreement
 *
 * You should have received a copy of the Alif Semiconductor Software
 * License Agreement with this file. If not, please write to:
 * contact@alifsemi.com, or visit: https://alifsemi.com/license
 *
 */


/ {
	aliases {
		dac = &dac0;
	};
};

&dac0{
	status = "okay";
};
```

## boards/alif_e7_dk_rtss_hp.overlay
```dts
/* Copyright (C) 2024 Alif Semiconductor - All Rights Reserved.
 * Use, distribution and modification of this code is permitted under the
 * terms stated in the Alif Semiconductor Software License Agreement
 *
 * You should have received a copy of the Alif Semiconductor Software
 * License Agreement with this file. If not, please write to:
 * contact@alifsemi.com, or visit: https://alifsemi.com/license
 *
 */


/ {
	aliases {
		dac = &dac1;
	};
};

&dac1{
	status = "okay";
};
```

## src/main.c
```c
/*
 * Copyright (C) 2024 Alif Semiconductor
 *
 * SPDX-License-Identifier: Apache-2.0
 */

#include <zephyr/kernel.h>
#include <zephyr/sys/printk.h>
#include <zephyr/drivers/dac.h>
#include <zephyr/device.h>
#include <zephyr/drivers/dac/alif_dac.h>
#include <stdint.h>
#include <zephyr/devicetree.h>

#define DAC_NODE	DT_ALIAS(dac)

/* DAC maximum resolution is 12-bit */
#define DAC_MAX_INPUT_VALUE   (0xFFF)
struct dac_channel_cfg dac_cfg;

int main(void)
{
	printk("\r\n >>>Starting up the Zephyr DAC demo!!! <<< \r\n");

	const struct device *const dac_dev = DEVICE_DT_GET(DAC_NODE);
	uint32_t input_value = 0;
	int32_t ret = 0;

	dac_cfg.channel_id = 0;
	dac_cfg.resolution = 12;
	dac_cfg.buffered = 0;

	/* Set DAC capacitance  */
	dac_set_capacitance(dac_dev, DAC_8PF_CAPACITANCE);

	/* Set DAC IBAIS output current */
	dac_set_output_current(dac_dev, DAC_1100UA_OUT_CUR);

	dac_channel_setup(dac_dev, &dac_cfg);

		if (ret != 0) {
			printk("\r\n Setup error:DAC_channel\n");
			return -1;
		}

	input_value = 0;

	while (1) {

		/* set dac input */
		dac_write_value(dac_dev, 0, input_value);

		if (ret != 0) {
			printk("\r\n Error: DAC Set Input failed\n");
			return -1;
		}

		/* Sleep for n micro second */
		k_msleep(2000);

		/* If the input value is equal to maximum
		 * dac input value then input
		 * value will be set to 0
		 */
		if (input_value == DAC_MAX_INPUT_VALUE) {
			input_value = 0;

		/* If the input value is not greater than the maximum
		 * dac input value then input
		 *value will be incremented by 1000 value
		 */
		} else {

			input_value += 1000;
		}
		/* If the input value is maximum than the maximum
		 * DAC input value then the input
		 *value will be set to DAC maximum input value
		 */
		if (input_value > DAC_MAX_INPUT_VALUE) {

			input_value = DAC_MAX_INPUT_VALUE;
		}

	}

	return 0;
}
```
