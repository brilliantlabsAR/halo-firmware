## CMakeLists.txt
```
# Copyright (C) 2024 Alif Semiconductor - All Rights Reserved.
# Use, distribution and modification of this code is permitted under the
# terms stated in the Alif Semiconductor Software License Agreement
#
# You should have received a copy of the Alif Semiconductor Software
# License Agreement with this file. If not, please write to:
# contact@alifsemi.com, or visit: https://alifsemi.com/license

cmake_minimum_required(VERSION 3.20.0)

if(NOT("${BOARD}" STREQUAL "alif_e3_dk_rtss_he" OR
	"${BOARD}" STREQUAL "alif_e3_dk_rtss_hp" OR
	"${BOARD}" STREQUAL "alif_e7_dk_rtss_he" OR
	"${BOARD}" STREQUAL "alif_e7_dk_rtss_hp" OR
	"${BOARD}" STREQUAL "alif_e7_dk_apss"))
	message(FATAL_ERROR "${BOARD} was not supported for this sample")
endif()
find_package(Zephyr REQUIRED HINTS $ENV{ZEPHYR_BASE})
project(hwsem)

option(HWSEM_ALL "Build test case to verify all HWSEMs" OFF)
option(HWSEM0 "Build test case to verify HWSEM0" ON)
if(HWSEM_ALL)
	target_sources(app PRIVATE src/hwsem_test_all.c)
elseif(HWSEM0)
	target_sources(app PRIVATE src/hwsem0_test.c)
endif()
```

## sample.yaml
```
---
sample:
  name: HWSEM driver sample
tests:
  sample.drivers.ipm:
    tags: HWSEM
    platform_allow:
      devkit_e7_ak_rtss_he devkit_e7_ak_rtss_hp devkit_e7_ak_apss devkit_e7_dk_rtss_he devkit_e7_dk_rtss_hp devkit_e7_dk_apss
```

## prj.conf
```kconfig
# Copyright (C) 2024 Alif Semiconductor - All Rights Reserved.
# Use, distribution and modification of this code is permitted under the
# terms stated in the Alif Semiconductor Software License Agreement
#
# You should have received a copy of the Alif Semiconductor Software
# License Agreement with this file. If not, please write to:
# contact@alifsemi.com, or visit: https://alifsemi.com/license

CONFIG_IPM=y
CONFIG_ALIF_HWSEM=y
CONFIG_LOG=y
CONFIG_IPM_LOG_LEVEL_DBG=y
CONFIG_LOG_MODE_MINIMAL=y
```

## boards/alif_e7_dk_apss.conf
```kconfig
# workaround to compile HWSEM test case for APSS.
CONFIG_ARM_MHUV2=y
```

## src/hwsem0_test.c
```c
/* Copyright (C) 2024 Alif Semiconductor - All Rights Reserved.
 * Use, distribution and modification of this code is permitted under the
 * terms stated in the Alif Semiconductor Software License Agreement
 *
 * You should have received a copy of the Alif Semiconductor Software
 * License Agreement with this file. If not, please write to:
 * contact@alifsemi.com, or visit: https://alifsemi.com/license
 *
 */
#include <zephyr/kernel.h>
#include <string.h>
#include <zephyr/drivers/hwsem_ipm.h>
#include <zephyr/logging/log.h>

#define LOG_MODULE_NAME alif_hwsem_log
LOG_MODULE_REGISTER(LOG_MODULE_NAME);
const struct device *hwsem0;

#if defined(CONFIG_SOC_E3_DK_RTSS_HP) || \
defined(CONFIG_SOC_E7_DK_RTSS_HP)
#define MASTER_ID 0xF00DF00D
#elif defined(CONFIG_SOC_E3_DK_RTSS_HE) || \
defined(CONFIG_SOC_E7_DK_RTSS_HE)
#define MASTER_ID 0xC0DEC0DE
#endif

int main(void)
{
	LOG_INF("Hardware Semaphore (HWSEM) example on %s\n", CONFIG_BOARD);
	hwsem0 = DEVICE_DT_GET(DT_NODELABEL(hwsem0));
	if (!device_is_ready(hwsem0)) {
		LOG_ERR("HWSEM0 not ready\n");
		return -1;
	}


	if (hwsem_lock(hwsem0, MASTER_ID)) {
		LOG_ERR("Unable to lock HWSEM0\n");
		return -1;
	}

	LOG_INF("Locked HWSEM0!\n");
	LOG_INF("Perform critical work here 1 !!!!\n");

	if (hwsem_lock(hwsem0, MASTER_ID)) {
		LOG_ERR("Unable to lock HWSEM0\n");
		hwsem_unlock(hwsem0, MASTER_ID);
		return -1;
	}
	LOG_INF("Locked HWSEM0!\n");
	LOG_INF("Perform critical work here 2 !!!!\n");

	if (hwsem_unlock(hwsem0, MASTER_ID)) {
		LOG_ERR("Unable to unlock HWSEM0\n");
		return -1;
	}
	LOG_INF("Unlocked HWSEM0!\n");

	if (hwsem_unlock(hwsem0, MASTER_ID)) {
		LOG_ERR("Unable to unlock HWSEM0\n");
		return -1;
	}
	LOG_INF("Unlocked HWSEM0!\n");

	return 0;
}
```

## src/hwsem_test_all.c
```c
/* Copyright (C) 2024 Alif Semiconductor - All Rights Reserved.
 * Use, distribution and modification of this code is permitted under the
 * terms stated in the Alif Semiconductor Software License Agreement
 *
 * You should have received a copy of the Alif Semiconductor Software
 * License Agreement with this file. If not, please write to:
 * contact@alifsemi.com, or visit: https://alifsemi.com/license
 *
 */
#include <zephyr/kernel.h>
#include <string.h>
#include <zephyr/drivers/hwsem_ipm.h>
#include <zephyr/logging/log.h>

#define LOG_MODULE_NAME alif_hwsem_log
LOG_MODULE_REGISTER(LOG_MODULE_NAME);
#define HWSEM_NUM 16

#if defined(CONFIG_SOC_E3_DK_RTSS_HP) || \
defined(CONFIG_SOC_E7_DK_RTSS_HP)
#define MASTER_ID 0xF00DF00D
#elif defined(CONFIG_SOC_E3_DK_RTSS_HE) || \
defined(CONFIG_SOC_E7_DK_RTSS_HE)
#define MASTER_ID 0xC0DEC0DE
#endif

const struct device *hwsem[16];

int main(void)
{
	int i = 0;

	LOG_INF("Test all 16 Hardware Semaphores(HWSEM) on %s\n", CONFIG_BOARD);
	hwsem[0] = DEVICE_DT_GET(DT_NODELABEL(hwsem0));
	hwsem[1] = DEVICE_DT_GET(DT_NODELABEL(hwsem1));
	hwsem[2] = DEVICE_DT_GET(DT_NODELABEL(hwsem2));
	hwsem[3] = DEVICE_DT_GET(DT_NODELABEL(hwsem3));
	hwsem[4] = DEVICE_DT_GET(DT_NODELABEL(hwsem4));
	hwsem[5] = DEVICE_DT_GET(DT_NODELABEL(hwsem5));
	hwsem[6] = DEVICE_DT_GET(DT_NODELABEL(hwsem6));
	hwsem[7] = DEVICE_DT_GET(DT_NODELABEL(hwsem7));
	hwsem[8] = DEVICE_DT_GET(DT_NODELABEL(hwsem8));
	hwsem[9] = DEVICE_DT_GET(DT_NODELABEL(hwsem9));
	hwsem[10] = DEVICE_DT_GET(DT_NODELABEL(hwsem10));
	hwsem[11] = DEVICE_DT_GET(DT_NODELABEL(hwsem11));
	hwsem[12] = DEVICE_DT_GET(DT_NODELABEL(hwsem12));
	hwsem[13] = DEVICE_DT_GET(DT_NODELABEL(hwsem13));
	hwsem[14] = DEVICE_DT_GET(DT_NODELABEL(hwsem14));
	hwsem[15] = DEVICE_DT_GET(DT_NODELABEL(hwsem15));
	for (i = 0; i < HWSEM_NUM ; ++i) {
		if (hwsem_trylock(hwsem[i], MASTER_ID)) {
			LOG_ERR("Unable to lock HWSEM%d\n", i);
			return -1;
		}
		LOG_INF("Locked HWSEM%d!\n", i);
		LOG_INF("Perform critical work here 1 !!!!\n");

		if (hwsem_trylock(hwsem[i], MASTER_ID)) {
			LOG_ERR("Unable to lock HWSEM%d\n", i);
			hwsem_unlock(hwsem[i], MASTER_ID);
			return -1;
		}
		LOG_INF("Locked HWSEM%d!\n", i);
		LOG_INF("Perform critical work here 2 !!!!\n");

		if (hwsem_unlock(hwsem[i], MASTER_ID)) {
			LOG_ERR("Unable to unlock HWSEM%d\n", i);
			return -1;
		}
		LOG_INF("Unlocked HWSEM%d!\n", i);

		if (hwsem_unlock(hwsem[i], MASTER_ID)) {
			LOG_ERR("Unable to unlock HWSEM%d\n", i);
			return -1;
		}
		LOG_INF("Unlocked HWSEM%d!\n", i);
	}
	return 0;
}
```
