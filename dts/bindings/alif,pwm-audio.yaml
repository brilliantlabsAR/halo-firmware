## modules/lua/Kconfig
```kconfig
menuconfig LUA
	bool "Lua runtime"
	select FILE_SYSTEM
	select POSIX_API
	select POSIX_FS
	select TIMER
	help
		This option enables the Lua runtime.

#if LUA

    config LUA_MAXSTACK
		int "Lua stack size"
		default 65536
		depends on LUA
		help
			This option sets the Lua stack size.

	config LUA_IDSIZE
		int "Lua identifier size"
		default 64
		depends on LUA
		help
			This option sets the Lua identifier size.

	config LUA_MAXINPUT
		int "Lua repl max input"
		default 512
		depends on LUA
		help 
			This option sets the lua repl max input 

module = LUA
module-str = lua
source "subsys/logging/Kconfig.template.log_config"

#endif
```

## samples/halo/qmc6308/sample.yaml
```yaml
sample:
  name: QMC6308 3-Axis Magnetometer
  description: 3-axis magnetic field measurement using QST QMC6308 magnetometer sensor
tests:
  sample.halo.qmc6308:
    platform_allow:
      - halo
    integration_platforms:
      - halo
    tags:
      - sensor
      - magnetometer
      - i2c
      - compass
    harness: console
    harness_config:
      type: multi_line
      regex:
        - "magn x:[-]?\\d+\\.\\d+ ms/2 y:[-]?\\d+\\.\\d+ ms/2 z:[-]?\\d+\\.\\d+ ms/2"
      ordered: false
```

## samples/halo/watchdog/sample.yaml
```yaml
sample:
  name: Watchdog Driver Sample
common:
  tags:
    - drivers
    - watchdog
  harness: console
  harness_config:
    type: multi_line
    ordered: true
    regex:
      - "Watchdog sample application"
      - "Feeding watchdog..."
      - "Waiting for reset..."
      - "Handled things..ready to reset"
  depends_on: watchdog
tests:
  sample.drivers.watchdog:
    platform_allow: halo
```
