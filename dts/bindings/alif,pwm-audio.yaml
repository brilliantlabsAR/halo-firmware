## dts/bindings/alif,pwm-audio.yaml
```yaml
# Copyright (c) 2025 Brilliant Labs Ltd
# SPDX-License-Identifier: Apache-2.0

description: ALIF PWM Audio Driver

compatible: "alif,pwm-audio"

include: [base.yaml, pinctrl-device.yaml]

properties:
  reg:
    required: true

  interrupts:
    required: true

  timer:
    type: int
    required: true
    default: 0
    description: |
      Timer number.
      The default is 0.
    enum:
      - 0
      - 1
      - 2
      - 3

  left:
    type: array
    required: true
    default:
      - -1
      - -1
    description: |
      Left channel configuration. <timer channel> 
  
  right:
    type: array
    default:
      - -1
      - -1
    description: |
      Right channel configuration. <timer channel>

  resolution:
    type: int
    default: 8
    description: |
      Audio resolution in bits.
    enum:
      - 8
      - 9
      - 10
      - 11
      - 12
  
  ringbuf-size:
    type: int
    default: 16384
    description: |
      Ringbuffer size in bytes.

  power-gpios:
    type: phandle-array
    required: false
    description: |
      Audio power control GPIO.



    
    
```

## dts/bindings/alif,t5838-alif-pdm.yaml
```yaml
# Copyright (c) 2025 Brilliant Labs Ltd
# SPDX-License-Identifier: Apache-2.0

description: ALIF PDM microphone driver enhanced for T5838

compatible: "alif,t5838-alif-pdm"

include: [base.yaml, pinctrl-device.yaml]

properties:
  reg:
    required: true

  interrupts:
    required: true

  queue-depth:
    type: int
    default: 32
    required: true
    description: |
      The number of buffers in the queue.
      The default is 16.

  fifo-watermark:
    type: int
    default: 4
    required: true
    description: |
      FIFO watermark level in bytes.
      The default is 4 bytes.
    enum:
      - 0
      - 1
      - 2
      - 3
      - 4
      - 5
      - 6
      - 7

  gain:
    type: int
    default: 1
    required: false
    description: |
      Gain level.
      The default is 1. (8.4 format)

  iir-bypass:
    type: boolean
    description: |
      IIR bypass. 
      The default is false.

  fir-bypass:
    type: boolean
    description: |
      FIR bypass. 
      The default is false.

  discard-duration-ms:
    type: int
    default: 0
    required: false
    description: |
      Duration in milliseconds of initial audio data to discard after trigger.
      The default is 0ms (discard disabled).
```

## dts/bindings/alif,vbat.yaml
```yaml
# SPDX-License-Identifier: Apache-2.0

description: Alif VBAT sensor
compatible: "alif,alif-vbat"
properties:

  adc:
    type: phandle
    required: true
    description: ADC device node

  channel:
    type: int
    required: true
    description: ADC channel number
  
  state-gpios:
    type: phandle-array
    required: false
    description: GPIO specifier for charge state

  output-ohms:
    type: int
    required: true
    description: Output resistor value in ohms

  full-ohms:
    type: int
    required: true
    description: Total resistance of voltage divider in ohms

  enable-gpios:
    type: phandle-array
    required: false
    description: GPIO specifier for power control

  charge-control-gpios:
    type: phandle-array
    required: false
    description: GPIO specifier for charge control (active low to disable charging)

  vin-supply:
    type: phandle
    required: false
    description: Phandle to the regulator node

  power-up-time-ms:
    type: int
    required: false
    default: 50
    description: Time to wait after power enable

  discharge-curve:
    type: array
    required: false
    description: |
      Voltage-SoC pairs in mV-% format
      e.g. <3000 0 3300 20 3500 50 3600 80 3700 100>

  voltage-filter-alpha:
    type: int
    required: false
    default: 50
    description: EMA filter coefficient 1/1000
```

## dts/bindings/bosch,bma580.yaml
```yaml
description: |
    Bosch bma580 accelerometer sensor.  See more info at:
    https://www.bosch-sensortec.com/products/motion-sensors/accelerometers/bma580/

compatible: "bosch,bma580"

include: ["i2c-device.yaml", "sensor-device.yaml"]

properties:
  int1-gpios:
    type: phandle-array
    description: |
      INT1 pin

      This pin defaults to active high when produced by the sensor.
      The property value should ensure the flags properly describe
      the signal that is presented to the driver.

  int2-gpios:
    type: phandle-array
    description: |
      INT2 pin

      This pin defaults to active high when produced by the sensor.
      The property value should ensure the flags properly describe
      the signal that is presented to the driver.


  int1-config:
    type: int
    description: |
      INT1 configuration bitfield.
      Bits:
        [0:1] Interrupt mode:
          0: disable
          1: latched
          2: short pulse
          3: long pulse
        [2] Drive mode:
          0: push-pull
          1: open-drain
        [3] Active level:
          0: active low
          1: active high
    default: 4  # disable, open-drain, active low

  int2-config:
    type: int
    description: |
      INT2 configuration bitfield.
      Bits:
        [0:1] Interrupt mode:
          0: disable
          1: latched
          2: short pulse
          3: long pulse
        [2] Drive mode:
          0: push-pull
          1: open-drain
        [3] Active level:
          0: active low
          1: active high
    default: 4  # disable, open-drain, active low

  odr:
    type: string
    description: |
      Default output data rate in Hz. Only the following values are allowed:
        1.5625 
        3.125
        6.25
        12.5
        25
        50
        100
        200
        400
        800
        1600
        3200
        6400
    default: "200"
    enum:
      - "1.5625"
      - "3.125"
      - "6.25"
      - "12.5"
      - "25"
      - "50"
      - "100"
      - "200"
      - "400"
      - "800"
      - "1600"
      - "3200"
      - "6400"

  range:
    type: int
    description: |
      Default range in g. Only the following values are allowed:
        2
        4
        8
        16
    default: 2
    enum:
      - 2
      - 4
      - 8
      - 16

  iir:
    type: int
    description: |
      Default IIR filter in dB. Only the following values are allowed:
        0
        20
        40
        60
    default: 0
    enum:
      - 0
      - 20
      - 40
      - 60

  noise:
    type: string
    description: |
      Default noise mode. Only the following values are allowed:
        "LOW"
        "HIGH"
    default: "LOW"
    enum:
      - "LOW"
      - "HIGH"
  
  bwp:
    type: int
    description: |
      Default bandwidth in Hz. Only the following values are allowed:
        0
        2
        4
        8
        16
        32
        64
    default: 2
    enum:
      - 0
      - 2
      - 4
      - 8
      - 16
      - 32
  
  pwr:
    type: string
    description: |
      Default power mode. Only the following values are allowed:
        LPM
        HPM
    default: "HPM"
    enum:
      - "LPM"
      - "HPM"

  lazy-init:
    type: boolean
    description: |
      If enabled, hardware initialization is deferred until first use (PM resume).
      This saves boot time and power consumption when display is not immediately needed.
      When false, hardware is initialized during driver init.
  
```

## dts/bindings/gpio-button.yaml
```yaml
# button.yaml
description: Software debounced button with single, double, long press detection

compatible: "gpio-button"

include: base.yaml

properties:
  gpios:
    type: phandle-array
    required: true
    description: GPIO pin the button is connected to

  debounce-ms:
    type: int
    required: false
    default: 20
    description: Debounce time in milliseconds

  long-press-ms:
    type: array
    required: true
    description: Multi-level long-press thresholds in milliseconds

  double-click-ms:
    type: int
    required: false
    default: 500
    description: Max time between two clicks for double click in ms
```

## dts/bindings/gz,vga020.yaml
```yaml
description: |
  VGA020 is a 320 * 240 resolution color micro OLED screen introduced by Guozhao Optoelectronics. 
  The device can be controlled via I2C and QSPI.

  &spi0{
    vga020:vga020@0 {
      compatible = "gz,vga020";
      reg = <0>;
      vpos-supply = <&vpos>;
      veng-supply = <&veng>;
      reset-gpios = <&gpio0 2 GPIO_ACTIVE_LOW>;
      width = <320>;
      height = <240>;
    }
  }

compatible: "gz,vga020"

include: [i2c-device.yaml, display-controller.yaml]

properties:
  mipi:
    type: phandle
    description: MIPI DSI device
  vpos-supply:
    type: phandle
    description: VPOS supply
  veng-supply:
    type: phandle
    description: VENG supply
  reset-gpios:
    type: phandle-array
    description: |
      The RESETn pin is asserted to disable the screen causing a hard
  lazy-init:
    type: boolean
    description: |
      If enabled, hardware initialization is deferred until first use (PM resume).
      This saves boot time and power consumption when display is not immediately needed.
      When false, hardware is initialized during driver init.
  
  
```

## dts/bindings/invensense,t5838-alif-pdm.yaml
```yaml
# Copyright (c) 2019 Nordic Semiconductor ASA
# Copyright (c) 2025 Brilliant Labs Ltd
# SPDX-License-Identifier: Apache-2.0

description: T5838 microphone driver using modified Alif PDM

compatible: "invensense,t5838-alif-pdm"

include: [base.yaml, pinctrl-device.yaml]

properties:
  reg:
    required: true

  micen-gpios:
    type: phandle-array
    required: false
    description: thsel pin

  thsel-gpios:
    type: phandle-array
    required: true
    description: thsel pin

  wake-gpios:
    type: phandle-array
    required: true
    description: wake pin

  pdmclk-gpios:
    type: phandle-array
    required: true
    description: pdmclk pin
```

## dts/bindings/maxim,max98357a.yaml
```yaml
# Copyright (c) 2024 Alif Semiconductor
# SPDX-License-Identifier: Apache-2.0

description: Maxim MAX98357A I2S Audio Amplifier

compatible: "maxim,max98357a"

properties:
  i2s:
    type: phandle
    required: true
    description: I2S interface phandle

  sd-mode-gpios:
    type: phandle-array
    description: |
      SD_MODE pin GPIO specification. This pin controls the amplifier shutdown.
      When high, the amplifier is enabled. When low, the amplifier is in shutdown mode.
```

## dts/bindings/pixart,pga7982.yaml
```yaml
# Copyright (c) 2021 Antmicro <www.antmicro.com>
# SPDX-License-Identifier: Apache-2.0

description: PAG7982 CMOS video sensor

compatible: "pixart,pag7982"

properties:
  power-gpios:
    type: phandle-array
    description: |
      The power pin is asserted to enable the sensor. 

  reset-gpios:
    type: phandle-array
    description: |
      The RESETn pin is asserted to disable the sensor causing a hard
      reset.  The sensor receives this as an active-low signal.

  pixclk:
    type: int
    description: Pixel clock frequency in Hz.
  
  frame-rate:
    type: int
    description: Frame rate in Hz.

  lazy-init:
    type: boolean
    description: |
      If enabled, hardware initialization is deferred until first use (PM resume).
      This saves boot time and power consumption when display is not immediately needed.
      When false, hardware is initialized during driver init.

include: i2c-device.yaml
```

## dts/bindings/qst,qmc6308.yaml
```yaml
description: |
    QST QMC6308 Magnetic sensor.  See more info at:
    https://www.qstcorp.com/en_comp_prod/QMC6308

compatible: "qst,qmc6308"

include: ["i2c-device.yaml", "sensor-device.yaml"]

properties:
  int-gpios:
    type: phandle-array
    description: |
      Interrupt GPIO pin.

  odr:
    type: int
    description: |
      Default output data rate in Hz. Only the following values are allowed:
        10
        50
        100
        200
        1500
    default: 200
    enum:
      - 10
      - 50
      - 100
      - 200
      - 1500

  range:
    type: int
    description: |
      Default range in guass. Only the following values are allowed:
        30
        12
        8
        2
    default: 30
    enum:
      - 30
      - 12
      - 8
      - 2
  
  mode:
    type: string
    description: |
      Default mode. Only the following values are allowed:
        Suspend
        Normal
        Single
        Continuous
    default: Normal
    enum:
      - "Suspend"
      - "Normal"
      - "Single"
      - "Continuous"

  ovs:
    type: int
    description: |
      Over sampling ratio. Only the following values are allowed:
        8
        4
        2
        1
    default: 8
    enum:
      - 8
      - 4
      - 2
      - 1

  ds:
    type: int
    description: |
      Down sampling ratio. Only the following values are allowed:
        1
        2
        4
        8
    default: 8
    enum:
      - 1
      - 2
      - 4
      - 8
      
  lazy-init:
    type: boolean
    description: |
      If enabled, hardware initialization is deferred until first use (PM resume).
      This saves boot time and power consumption when display is not immediately needed.
      When false, hardware is initialized during driver init.
  
```

## dts/bindings/sm-gpio.yaml
```yaml
description: |
  Ship Mode GPIO Controller
  
  This binding describes a GPIO-controlled ship mode device. Ship mode is an
  ultra-low power state used during product shipping to preserve battery life.
  
  When activated, the device enters ship mode by setting the specified GPIO
  pin high. The device can typically only be woken up by a hardware reset or
  power cycle.
  
  Example usage:
  
    shipmode: shipmode {
        compatible = "sm-gpio";
        gpios = <&gpio6 0 GPIO_ACTIVE_HIGH>;
        label = "Ship Mode Control";
        status = "okay";
    };
  
    aliases {
        shipmode = &shipmode;
    };

compatible: "sm-gpio"

include: base.yaml

properties:
  gpios:
    type: phandle-array 
    required: true
    description: |
      GPIO pin used to trigger ship mode. When this pin is set high,
      the device enters ship mode. The pin should be configured as
      GPIO_ACTIVE_HIGH in most cases.
      
  label:
    type: string       
    required: false
    description: |
      Human-readable label for the ship mode device. This is optional
      and used primarily for debugging and identification purposes.
```
