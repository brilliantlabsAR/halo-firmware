## drivers/regulator/Kconfig.tps65132
```kconfig
# Copyright (C) 2025 Brilliant Labs
# SPDX-License-Identifier: Apache-2.0

config REGULATOR_TPS65132
	bool "TI TPS65132 PMIC regulator driver"
	default y
	depends on DT_HAS_TI_TPS65132_ENABLED
	select I2C
	help
	  Enable the TI TPS65132 PMIC regulator driver

if REGULATOR_TPS65132

config REGULATOR_TPS65132_COMMON_INIT_PRIORITY
	int "TI TPS65132 regulator driver init priority (common part)"
	default 61
	help
	  Init priority for the TI TPS65132 regulator driver (common part). It
	  must be greater than I2C init priority.

config REGULATOR_TPS65132_VPOS_INIT_PRIORITY
	int "TI TPS65132 regulator driver vpos init priority"
	default 62
	help
	  Init priority for the TI TPS65132 regulator driver. It must be
	  greater than REGULATOR_TPS65132_COMMON_INIT_PRIORITY.


config REGULATOR_TPS65132_VENG_INIT_PRIORITY
	int "TI TPS65132 regulator driver veng init priority"
	default 63
	help
	  Init priority for the TI TPS65132 regulator driver. It must be
	  greater than REGULATOR_TPS65132_COMMON_INIT_PRIORITY.

endif
```

## drivers/sensor/Kconfig
```kconfig
if SENSOR

rsource "Kconfig.bma580"
rsource "Kconfig.qmc6308"
rsource "Kconfig.alif_vbat"

endif
```

## drivers/sensor/Kconfig.alif_vbat
```kconfig
config ALIF_VBAT
	bool "Alif VBAT Sensor"
    default y
    select ADC
    depends on DT_HAS_ALIF_ALIF_VBAT_ENABLED
    depends on SOC_SERIES_BALLETTO_B1
	help
       Enable the driver for Alif VBAT sensors

if ALIF_VBAT

choice
	prompt "Trigger mode"
	default ALIF_VBAT_TRIGGER_GLOBAL_THREAD
	help
	  Specify the type of triggering to be used by the driver.

config ALIF_VBAT_TRIGGER_NONE
	bool "No trigger"

config ALIF_VBAT_TRIGGER_GLOBAL_THREAD
	bool "Use global thread"
	depends on GPIO
	select ALIF_VBAT_TRIGGER

config ALIF_VBAT_TRIGGER_OWN_THREAD
	bool "Use own thread"
	depends on GPIO
	select ALIF_VBAT_TRIGGER

endchoice

config ALIF_VBAT_TRIGGER
    bool 

config ALIF_VBAT_THREAD_PRIORITY
	int "Thread priority"
	depends on ALIF_VBAT_TRIGGER_OWN_THREAD
	default 10
	help
	  Priority of thread used by the driver to handle interrupts.

config ALIF_VBAT_THREAD_STACK_SIZE
	int "Thread stack size"
	depends on ALIF_VBAT_TRIGGER_OWN_THREAD
	default 1024
	help
	  Stack size of thread used by the driver to handle interrupts.

endif # ALIF_VBAT
```

## drivers/sensor/Kconfig.bma580
```kconfig
config BMA580
	bool "Bosch 3-axis Acceleration Sensor"
    default y
    depends on DT_HAS_BOSCH_BMA580_ENABLED
    select I2C
	help
       Enable driver for Bosch BMA580 (I2C-based)


if BMA580

choice
	prompt "Trigger mode"
	default BMA580_TRIGGER_GLOBAL_THREAD
	help
	  Specify the type of triggering to be used by the driver.

config BMA580_TRIGGER_NONE
	bool "No trigger"

config BMA580_TRIGGER_GLOBAL_THREAD
	bool "Use global thread"
	depends on GPIO
	select BMA580_TRIGGER

config BMA580_TRIGGER_OWN_THREAD
	bool "Use own thread"
	depends on GPIO
	select BMA580_TRIGGER

endchoice

config BMA580_TRIGGER
	bool

config BMA580_THREAD_PRIORITY
	int "Thread priority"
	depends on BMA580_TRIGGER_OWN_THREAD
	default 10
	help
	  Priority of thread used by the driver to handle interrupts.

config BMA580_THREAD_STACK_SIZE
	int "Thread stack size"
	depends on BMA580_TRIGGER_OWN_THREAD
	default 1024
	help
	  Stack size of thread used by the driver to handle interrupts.

endif # BMA580
```

## drivers/sensor/Kconfig.qmc6308
```kconfig
config QMC6308
	bool "QST 3-axis Magnetic Sensor"
    default y
    depends on DT_HAS_QST_QMC6308_ENABLED
    select I2C
	help
       Enable driver for QST QMC6308 (I2C-based)
```

## drivers/sm/Kconfig.sm
```kconfig
# Copyright (C) 2025 Brilliant Labs
# SPDX-License-Identifier: Apache-2.0

menuconfig SM_GPIO
	bool "Ship Mode GPIO Driver"
	default y
	depends on GPIO
	help
	  Enable support for GPIO-controlled ship mode. Ship mode is an
	  ultra-low power state used during product shipping to preserve
	  battery life. When activated, the device enters ship mode by
	  setting a GPIO pin high. The device typically requires a hardware
	  reset or power cycle to wake up from ship mode.

if SM_GPIO

module = SHIPMODE
module-str = shipmode
source "subsys/logging/Kconfig.template.log_config"

endif # SM_GPIO
```

## drivers/video/Kconfig
```kconfig
if VIDEO
 
rsource "Kconfig.pag7982"

module = VIDEO
module-str = VIDEO
source "subsys/logging/Kconfig.template.log_config"

endif
```

## drivers/video/Kconfig.pag7982
```kconfig
# PAG7982

config VIDEO_PAG7982
	bool "PAG7982 CMOS digital image sensor"
	select I2C
	depends on DT_HAS_PIXART_PAG7982_ENABLED
	default y
	help
	  Enable driver for PAG7982 CMOS digital image sensor device.
```
