## boards/arm/halo/Kconfig.board
```kconfig
# Copyright (c) 2024 Alif Semiconductor
# Copyright (c) 2025 Brilliant Labs
# SPDX-License-Identifier: Apache-2.0

config HALO_BOARD
	bool "HALO (Balletto B1)"
	depends on SOC_SERIES_BALLETTO_B1

if HALO_BOARD

config UART_DMA_ENABLE
	bool
endif
```

## boards/arm/halo/Kconfig.defconfig
```kconfig
# Copyright (c) 2024 Alif Semiconductor
# Copyright (c) 2025 Brilliant Labs
# SPDX-License-Identifier: Apache-2.0

if HALO_BOARD

config BOARD
	default "halo"
endif # HALO_BOARD

config MAIN_STACK_SIZE
	default 4096

config BT_BUF_ACL_RX_SIZE
	range 251 65535
	default 251

config BT_BUF_EVT_RX_COUNT
	default 20 if (BT_MESH && !(BT_BUF_EVT_DISCARDABLE_COUNT > 0))
	default 10
	range 10 255

config BT_BUF_ACL_RX_COUNT
	default 10
	range 6 255

config BT_BUF_ACL_TX_COUNT
	default 10
	range 6 255

config UART_DMA_ENABLE
	default y if BT
	default y if IEEE802154_ALIF_SUPPORT
	select DMA
	select UART_ASYNC_API
	select RING_BUFFER
```

## boards/arm/halo/halo_defconfig
```kconfig
# Copyright (c) 2024 Alif Semiconductor
# Copyright (c) 2025 Brilliant Labs
# SPDX-License-Identifier: Apache-2.0

CONFIG_SOC_B1_DK_RTSS_HE_A5=y
CONFIG_SOC_SERIES_BALLETTO_B1=y
CONFIG_CORTEX_M_SYSTICK=y
CONFIG_RUNTIME_NMI=y
CONFIG_ARM_MPU=y
CONFIG_PINCTRL=y
CONFIG_SERIAL=y
CONFIG_FPU=y
CONFIG_FP_HARDABI=y
CONFIG_UART_INTERRUPT_DRIVEN=y
CONFIG_CONSOLE=y
CONFIG_UART_CONSOLE=y

CONFIG_SYS_CLOCK_HW_CYCLES_PER_SEC=160000000

# Zephyr Kernel Configuration
CONFIG_XIP=y
CONFIG_GPIO=y
CONFIG_GPIO_DW=y
CONFIG_SOC_SUPPORT_ARM_MHUV2=y
CONFIG_CLOCK_CONTROL=y

# Cache Management
CONFIG_CACHE_MANAGEMENT=y

# LLVM Arm toolchain 16.0.0 does not recognize --gap-fill
CONFIG_BUILD_NO_GAP_FILL=y

CONFIG_UART_NS16550=y
# UART variant of ns16550 that supports auto flow control
CONFIG_UART_NS16550_VARIANT_NS16750=y
# Support break condition
CONFIG_UART_LINE_CTRL=y
CONFIG_UART_NS16550_LINE_CTRL=y


# Set Kernel device Priority levels
CONFIG_KERNEL_INIT_PRIORITY_DEFAULT=0
CONFIG_SE_SERVICE_INIT_PRIORITY=1
CONFIG_GPIO_INIT_PRIORITY=40

CONFIG_REGULATOR=y
CONFIG_REGULATOR_FIXED_INIT_PRIORITY=50

CONFIG_INPUT=y
CONFIG_ALIF_BLE_ROM_IMAGE_V1_2=y
```

## drivers/audio/Kconfig
```kconfig
if AUDIO

rsource "t5838/Kconfig"
rsource "pwm_audio/Kconfig"
rsource "max98357a/Kconfig"

endif
```

## drivers/audio/max98357a/Kconfig
```kconfig
# MAX98357A audio driver configuration

config MAX98357A_AUDIO
	bool "MAX98357A I2S Audio Amplifier Driver (DMA buffered)"
	depends on I2S
	help
	  Enable MAX98357A I2S audio amplifier driver using internal DMA block buffering.

if MAX98357A_AUDIO

config MAX98357A_AUDIO_INIT_PRIORITY
	int "MAX98357A audio driver initialization priority"
	default 70
	help
	  Initialization priority for MAX98357A audio driver.

config MAX98357A_AUDIO_TX_SLAB_COUNT
	int "Number of TX memory slabs"
	default 4
	range 2 8
	help
	  Number of memory slabs for I2S TX blocks.

config MAX98357A_AUDIO_SYNC_BLOCK_SIZE
		int "MAX98357A sync DMA block size (bytes)"
		default 1024
		range 256 4096
		help
			Size of each DMA block provided to i2s_sync. Larger blocks reduce callback rate
			but increase latency.

config MAX98357A_AUDIO_SYNC_BLOCK_COUNT
		int "MAX98357A sync DMA block count"
		default 4
		range 2 16
		help
			Number of pre-allocated DMA blocks for TX buffering in sync mode.

## Work queue removed in sync mode

config MAX98357A_AUDIO_GENERIC_API
	bool "Use generic audio API interface"
	default y
	help
	  Enable generic audio API interface for MAX98357A audio driver.
	  When enabled, the driver will provide both MAX98357A-specific and
	  generic audio APIs, allowing unified audio interface usage.

config MAX98357A_AUDIO_PROTECTION_EQ
	bool "Apply speaker current-protection DSP chain"
	default y
	help
	  Protect the bone-conduction transducers (and the battery protection
	  IC) with a DSP chain applied post-volume, so thresholds reference
	  absolute output level: 2nd-order HPF, static voicing EQ (loudness
	  rebalance toward the audible bands), a current-proxy energy limiter
	  whose bench-calibrated sidechain tracks transducer drive amplitude,
	  an onset ramp, and a soft-knee true-peak clipper.

	  Replaces the previous static EQ + instant peak limiter: protection
	  now tracks short-term weighted signal ENERGY (what actually trips
	  the battery IC's over-current detection) instead of sample peaks,
	  allowing much milder static low-frequency cuts.

if MAX98357A_AUDIO_PROTECTION_EQ

config MAX98357A_AUDIO_PROTECT_HPF_HZ
	int "Protection high-pass cutoff (Hz), 0 disables"
	default 200
	range 0 500
	help
	  2nd-order Butterworth high-pass removing content below the
	  bone-conduction transducer's efficient region, where drive current
	  buys felt vibration rather than audible loudness. 200 Hz was chosen
	  by blinded on-head A/B together with the rebalanced voicing curve:
	  louder speech at equal buzz. Voice fundamentals below the cutoff are
	  deliberately traded away; the psychoacoustic bass enhancer
	  (MAX98357A_AUDIO_BASS_ENHANCE_PERCENT) can restore perceived
	  fullness without the current draw.

config MAX98357A_AUDIO_PROTECT_BUDGET_PERCENT
	int "Energy limiter budget, percent of full scale"
	default 60
	range 10 100
	help
	  Current budget for the energy limiter, as a percentage of int16 full
	  scale for a hypothetical weight-1.0 signal. All bands carry a
	  uniform current weight of 3.0 (bench calibration showed supply
	  current tracks drive amplitude, not frequency), so a sustained sine
	  in any band is allowed budget/3 of full scale.

	  Bench-calibrated at 3.7 V through the full chain: audio draw at the
	  budget-80 ceiling measured ~72 mA above baseline, which keeps the
	  per-pack share plus quiescent system load under the battery
	  protection IC's minimum over-discharge trip (50 mA @ 20 ms) with
	  the display in power save. While the display is active its extra
	  load rides the same protection IC, so the effective budget is
	  reduced by MAX98357A_AUDIO_PROTECT_DISPLAY_BUDGET_DROP points.

	  To recalibrate: play full-scale sine sweeps, BROADBAND NOISE, and
	  real TTS at max volume, measure battery current, and pick the
	  largest value that stays below the protection IC's trip point with
	  margin.

config MAX98357A_AUDIO_PROTECT_PEAK_CAP_PERCENT
	int "True-peak weighted-drive cap, percent of full scale (0 disables)"
	default 300
	range 0 1000
	help
	  Instantaneous cap on the current-weighted output amplitude, in the
	  same units as the energy budget. The energy limiter's sidechain
	  integrates over ~PROTECT_ENV_MS and is blind to the first
	  milliseconds of a transient, but the battery protection IC's
	  short-circuit comparator reacts in hundreds of microseconds -
	  on hardware, a pregain-boosted fricative onset latched the IC
	  while sustained content at the same budget survived. This clamp
	  reacts within one sample (instant attack, ~4 ms release).

	  Normal speech peaks reach roughly 150-200 % weighted; the
	  transients that tripped the IC computed at 400 %+. The default
	  300 sits between: inaudible in normal operation, engaged only on
	  trip-class spikes. Must sit above the energy budget (the budget
	  needs crest headroom to do its job).

config MAX98357A_AUDIO_PROTECT_DISPLAY_BUDGET_DROP
	int "Budget reduction while the display is active (percent points)"
	default 20
	range 0 60
	help
	  While the display is out of power save, its supply current (bench:
	  ~19 mA above the idle baseline, ~30 mA total system load) rides the
	  same battery-protection IC as the audio path's larger share. The
	  effective energy-limiter budget is reduced by this many points for
	  as long as the display is active, and restored when it returns to
	  power save - applied as a smooth ramped step even mid-stream.

	  With the calibrated budget->current mapping, the default 20-point
	  drop (80 -> 60) keeps the worst-case display-on draw near the
	  protection IC's minimum trip threshold; raise the drop if a unit
	  with a low-trip IC sample still cuts out during display-on
	  playback, or set 0 to disable the coupling entirely.

	  Note the audible consequence: content played with the display on
	  is up to ~2 dB quieter at the loudness ceiling than display-off
	  playback. Senders that want full speech loudness should blank the
	  display during playback.

config MAX98357A_AUDIO_PROTECT_ENV_MS
	int "Energy limiter integration window (ms)"
	default 3
	range 1 10
	help
	  Sidechain leaky-integrator time constant. Match to the battery
	  protection IC's over-current detection delay: shorter reacts faster
	  but limits brief transients the IC would have tolerated.

config MAX98357A_AUDIO_PROTECT_HOLD_MS
	int "Energy limiter hold (ms)"
	default 20
	range 0 500
	help
	  Time the limiter holds its gain after the signal falls back under
	  budget, before release begins. Prevents gain ripple within
	  low-frequency cycles and rapid pumping on syllabic content.

config MAX98357A_AUDIO_PROTECT_RELEASE_MS
	int "Energy limiter release time constant (ms)"
	default 150
	range 10 2000
	help
	  Exponential gain recovery time constant after hold expires. Slow
	  enough that gain does not track individual low-frequency cycles
	  (which would cause harmonic distortion).

config MAX98357A_AUDIO_PROTECT_RAMP_MS
	int "Stream onset ramp (ms), 0 disables"
	default 15
	range 0 100
	help
	  Fade-in applied when a stream (re)starts, spreading amplifier
	  turn-on inrush current so it does not coincide with a full-level
	  first buffer (a classic battery-protection trip scenario).

config MAX98357A_AUDIO_BASS_ENHANCE_PERCENT
	int "Psychoacoustic bass harmonic drive (percent), 0 disables"
	default 0
	range 0 200
	help
	  Recover perceived bass fullness without the current draw: the
	  60-240 Hz band (which the HPF and protection remove from the
	  transducer) is full-wave rectified to generate even harmonics,
	  band-shaped into 180-900 Hz and mixed back in before the HPF.
	  The ear reconstructs the missing fundamental from the harmonic
	  series, so TTS voice sounds full while the transducer is never
	  driven at the frequencies that trip the battery IC.

	  The harmonics enter the chain ahead of the sidechain and limiter,
	  so this cannot raise output energy past the protection budget.

	  100 mixes the shaped harmonics at unity relative to the extracted
	  band; tune by ear (60-120 is a sensible range). Note the lower
	  half of the harmonic band (180-425 Hz) is inside the vibrotactile
	  range, so verify felt vibration (not just sound) when raising it.

config MAX98357A_AUDIO_PROTECT_TUNING
	bool "Runtime protection-chain tuning API (bench/lab builds)"
	default n
	help
	  Expose max98357a_audio_protect_tune()/get()/stats(): runtime
	  overrides for the HPF cutoff, energy budget, limiter timing, static
	  voicing gains and sidechain current weights, plus a digital pre-gain
	  and limiter-activity telemetry. For bench characterisation and
	  listening-test builds; leave off in production images.

endif # MAX98357A_AUDIO_PROTECTION_EQ

endif # MAX98357A_AUDIO
```

## drivers/audio/pwm_audio/Kconfig
```kconfig
# Audio PWM Speaker configuration options

# Copyright (C) 2025 Brilliant Labs
# SPDX-License-Identifier: Apache-2.0

menuconfig PWM_AUDIO
	bool "PWM Audio Output Drivers For Alif"
	default y
	depends on DT_HAS_ALIF_PWM_AUDIO_ENABLED
	select RING_BUFFER
	help
	  Enable ALIF PWM Audio Output Driver Configuration.

if PWM_AUDIO

module = PWM_AUDIO
module-str = pwm out driver for alif
source "subsys/logging/Kconfig.template.log_config"

config PWM_AUDIO_INIT_PRIORITY
	int "Init priority"
	default 80
	help
		PWM Audio Output device driver initialization priority.

config PWM_AUDIO_GENERIC_API
	bool "Use generic audio API interface"
	default y
	help
	  Enable generic audio API interface for PWM audio driver.
	  When enabled, the driver will provide both PWM-specific and
	  generic audio APIs, allowing unified audio interface usage.

endif # PWM_AUDIO
```

## drivers/audio/t5838/Kconfig
```kconfig
# Audio Codec configuration options

# Copyright (c) 2018 Intel Corporation
# Copyright (c) 2025 Brilliant Labs
# SPDX-License-Identifier: Apache-2.0

menuconfig T5838
    bool "Digital Microphone (Audio) Drivers"
    default y
    depends on DT_HAS_INVENSENSE_T5838_ALIF_PDM_ENABLED
    help
        Enable Digital Microphone Driver Configuration.

if T5838

module = T5838
module-str = T5838 microphone driver for alif pdm
source "subsys/logging/Kconfig.template.log_config"

config T5838_INIT_PRIORITY
    int "Init priority"
    default 80
    help
        Audio Digital Microphone device driver initialization priority.

config T5838_AAD_TRIGGER
    bool "Enable AAD functionality"
    default y
    depends on GPIO
    help
        Enable Acoustic Activity Detection (AAD) triggering functionality.

choice
    prompt "AAD Trigger mode"
    default T5838_AAD_TRIGGER_GLOBAL_THREAD
    help
        Specify the type of triggering to be used by the AAD functionality.

config T5838_AAD_TRIGGER_NONE
    bool "No trigger"
    help
        No triggering mechanism is used for AAD interrupts.

config T5838_AAD_TRIGGER_GLOBAL_THREAD
    bool "Use global thread"
    depends on GPIO
    select T5838_AAD_TRIGGER
    help
        Use a global work queue to handle AAD wake interrupts.

config T5838_AAD_TRIGGER_OWN_THREAD
    bool "Use own thread"
    depends on GPIO
	select T5838_AAD_TRIGGER
    help
        Use a dedicated thread to handle AAD wake interrupts.

endchoice

config T5838_AAD_TRIGGER_THREAD_PRIORITY
    int "Thread priority"
    depends on T5838_AAD_TRIGGER_OWN_THREAD
    default 10
    help
        Priority of the thread used by the driver to handle AAD wake interrupts.

config T5838_AAD_TRIGGER_STACK_SIZE
    int "Thread stack size"
    depends on T5838_AAD_TRIGGER_OWN_THREAD
    default 1024
    help
        Stack size of the thread used by the driver to handle AAD wake interrupts.

endif # T5838
```

## drivers/display/Kconfig.vga020
```kconfig
# Copyright (C) 2025 Brilliant Labs
# SPDX-License-Identifier: Apache-2.0

config VGA020
	bool "VGA020 display driver"
	depends on ! CONFIG_CDC200
	default y
	depends on DT_HAS_GZ_VGA020_ENABLED
	help
		Enable support for VGA020 driver controller
```

## drivers/input/Kconfig.gpio_button
```kconfig
# Copyright (C) 2025 Brilliant Labs
# SPDX-License-Identifier: Apache-2.0

config INPUT_GPIO_BUTTON
	bool "GPIO Button input driver"
	default y
	depends on DT_HAS_GPIO_BUTTON_ENABLED
	depends on GPIO
	help
		Enable support for GPIO Button input driver.

if INPUT_GPIO_BUTTON

choice
    prompt "Trigger mode"
	default INPUT_GPIO_BUTTON_OWN_THREAD
	help
		Specify the type of triggering to be used by the driver.
		
config INPUT_GPIO_BUTTON_GLOBAL_THREAD
	bool "Use global thread"
	depends on GPIO

config INPUT_GPIO_BUTTON_OWN_THREAD
	bool "Use own thread"
	depends on GPIO

endchoice

if INPUT_GPIO_BUTTON_OWN_THREAD

config INPUT_GPIO_BUTTON_THREAD_PRIORITY
	int "Thread priority"
	depends on INPUT_GPIO_BUTTON_OWN_THREAD
	default 3
	help
	  Priority of thread used by the driver to handle interrupts.

config INPUT_GPIO_BUTTON_THREAD_STACK_SIZE
	int "Thread stack size"
	depends on INPUT_GPIO_BUTTON_OWN_THREAD
	default 8192
	help
	  Stack size of thread used by the driver to handle interrupts.
endif

endif
```

## drivers/led_pwm/Kconfig.led
```kconfig
# Copyright (C) 2025 Brilliant Labs
# SPDX-License-Identifier: Apache-2.0

config LED_PWM
	bool "PWM LED driver"
	default n
	depends on PWM
	help
		Enable support for PWM LED driver.

config LED_INIT_PRIORITY
    int "LED driver initialization priority"
    default 50
    help
      Initialization priority for LED drivers.
```
