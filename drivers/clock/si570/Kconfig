## drivers/clock/si570/Kconfig
```kconfig
# Copyright (C) 2023 Alif Semiconductor - All Rights Reserved.
# Use, distribution and modification of this code is permitted under the
# terms stated in the Alif Semiconductor Software License Agreement
#
# You should have received a copy of the Alif Semiconductor Software
# License Agreement with this file. If not, please write to:
# contact@alifsemi.com, or visit: https://alifsemi.com/license

menuconfig SI570
	bool "SI570 programmable oscillator"
	depends on I2C
	help
		Enable I2C based driver for SI570 programmable oscillator.

if SI570

config SI570_INIT_PRIORITY
	int "Initialisation priority for SI570 driver"
	default 60
	help
		The initialisation priority affects the order in which drivers are initialised. A smaller
		value means the driver will be initialised earlier. This must be set to a value greater
		than the init priority of the I2C bus that the SI570 driver depends upon, so that the SI570
		is initialised after the bus.

module = SI570
module-str = si570
source "subsys/logging/Kconfig.template.log_config"

endif
```

## drivers/codec/wm8904/Kconfig
```kconfig
# Copyright (C) 2023 Alif Semiconductor - All Rights Reserved.
# Use, distribution and modification of this code is permitted under the
# terms stated in the Alif Semiconductor Software License Agreement
#
# You should have received a copy of the Alif Semiconductor Software
# License Agreement with this file. If not, please write to:
# contact@alifsemi.com, or visit: https://alifsemi.com/license

menuconfig WM8904
	bool "WM8904 programmable oscillator"
	depends on I2C
	help
		Enable I2C based driver for WM8904 audio codec.

if WM8904

config WM8904_MONO_OUTPUT_MODE
	bool "Mono mode: duplicate left channel input on both outputs"
	default n
	help
		Setting mono mode causes the WM8904 to output the left channel on both the left and right
		outputs. This is useful in case your I2S signal contains only one channel.

config WM8904_INIT_PRIORITY
	int "Initialisation priority for WM8904 driver"
	default 60
	help
		The initialisation priority affects the order in which drivers are initialised. A smaller
		value means the driver will be initialised earlier. This must be set to a value greater
		than the init priority of the I2C bus that the WM8904 driver depends upon, so that the
		WM8904 is initialised after the bus.

module = WM8904
module-str = wm8904
source "subsys/logging/Kconfig.template.log_config"

endif
```

## drivers/i2s/Kconfig
```kconfig
# Copyright (C) 2023 Alif Semiconductor - All Rights Reserved.
# Use, distribution and modification of this code is permitted under the
# terms stated in the Alif Semiconductor Software License Agreement
#
# You should have received a copy of the Alif Semiconductor Software
# License Agreement with this file. If not, please write to:
# contact@alifsemi.com, or visit: https://alifsemi.com/license

rsource "i2s_sync/Kconfig"
```

## drivers/i2s/i2s_sync/Kconfig
```kconfig
# Copyright (C) 2023 Alif Semiconductor - All Rights Reserved.
# Use, distribution and modification of this code is permitted under the
# terms stated in the Alif Semiconductor Software License Agreement
#
# You should have received a copy of the Alif Semiconductor Software
# License Agreement with this file. If not, please write to:
# contact@alifsemi.com, or visit: https://alifsemi.com/license

menuconfig I2S_SYNC
	bool "Alif I2S sync driver"
	default y
	depends on I2S && DT_HAS_ALIF_I2S_SYNC_ENABLED
	help
		Enable Alif I2S driver with synchronisation

if I2S_SYNC

config I2S_SYNC_BUFFER_FORMAT_SEQUENTIAL
	bool "I2S buffer format uses L and R channels in sequential blocks rather than interleaved"
	default n
	help
		By default the I2S buffer format interleaves the left and right channel samples:
		{left_0, right_0, left_1, right_1, ..., left_n, right_n}

		This option uses left and right channels in sequential blocks:
		{left_0, left_1, ..., left_n, right_0, right_1, ..., right_n}

		This is advantageous for some applications, e.g. for bluetooth LE audio the LC3 codec is a
		single channel codec, so expects a single left or right channel to be in one continuous
		block. Therefore it can be more efficient for the I2S driver to directly use this buffer
		format instead of having to interleave/de-interleave the data as a separate step.

module = I2S_SYNC
module-str = i2s-sync
source "subsys/logging/Kconfig.template.log_config"

endif
```

## dts/bindings/skyworks,si570.yaml
```yaml
# Copyright (C) 2023 Alif Semiconductor - All Rights Reserved.
# Use, distribution and modification of this code is permitted under the
# terms stated in the Alif Semiconductor Software License Agreement
#
# You should have received a copy of the Alif Semiconductor Software
# License Agreement with this file. If not, please write to:
# contact@alifsemi.com, or visit: https://alifsemi.com/license

compatible: "skyworks,si570"

description: Skyworks SI570 programmable oscillator

include: i2c-device.yaml

properties:
  factory-fout:
    type: int
    required: true

  initial-freq:
    type: int
    required: false
```

## modules/linker/Kconfig
```kconfig
# Alif SDK Linker Module Kconfig options

menuconfig ALIF_LINKER_WORKAROUNDS
	bool "Enable Alif linker workarounds"
	default y if "$(ZEPHYR_TOOLCHAIN_VARIANT)" = "llvm"
	help
	  This option enables linker workarounds for known issues with LLVM/Clang
	  compiler, particularly for handling exception tables and RAM functions.
	  It's automatically enabled when using LLVM/Clang without exceptions.
	  The workarounds are not needed when exceptions are enabled, as the
	  exception tables are required in that case.

if ALIF_LINKER_WORKAROUNDS

config ALIF_DISCARD_EXCEPTION_TABLES
	bool "Discard exception tables"
	default y if !EXCEPTIONS
	help
	  This option discards exception tables (.ARM.exidx sections) that are
	  generated by LLVM/Clang even when exceptions are disabled. This prevents
	  linker errors when RAM functions are placed too far from their call sites.

	  On Alif hardware, this issue is particularly problematic because MRAM
	  (at ~0x80000000) and TCM (at ~0x00000000) are more than 1GB apart,
	  exceeding the ARM EABI R_ARM_PREL31 relocation limit.

	  See README.md in the linker module for more details.

config ALIF_FIX_SYMBOL_WARNINGS
	bool "Fix symbol table placement warnings"
	default y
	help
	  This option adds a linker script fragment that properly handles symbol
	  table placement to avoid warnings from the LLVM linker (ld.lld) about
	  symbol tables being placed in their respective sections.

	  These warnings are harmless but can clutter the build output.

endif
```

## samples/drivers/display/boards/alif_e7_dk_rtss_hp.conf
```kconfig
# Copyright (C) 2024 Alif Semiconductor - All Rights Reserved.
# Use, distribution and modification of this code is permitted under the
# terms stated in the Alif Semiconductor Software License Agreement
#
# You should have received a copy of the Alif Semiconductor Software
# License Agreement with this file. If not, please write to:
# contact@alifsemi.com, or visit: https://alifsemi.com/license

CONFIG_HEAP_MEM_POOL_SIZE=81920
```

## samples/drivers/ipm/ipm_arm_mhuv2/rtss_hp/sample.yaml
```yaml
---
sample:
  name: MHUv2 driver sample
tests:
  sample.drivers.ipm:
    tags: MHUv2
    platform_allow:
      alif_e7_ak_rtss_hp alif_e7_dk_rtss_hp alif_e3_ak_rtss_hp alif_e3_ak_rtss_hp
```

## samples/modules/tflite-micro/alif_kws/Kconfig
```kconfig
# Copyright (C) 2025 Alif Semiconductor - All Rights Reserved.
# Use, distribution and modification of this code is permitted under the
# terms stated in the Alif Semiconductor Software License Agreement
#
# You should have received a copy of the Alif Semiconductor Software
# License Agreement with this file. If not, please write to:
# contact@alifsemi.com, or visit: https://alifsemi.com/license

config USE_APP_MENU
	bool "Use application menu to choose a test case"
	default false

config ACTIVATION_BUF_SECTION
	string "Linker section where activation buffer (tensor arena) is placed"
	default ".bss.activation_buf"

config ACTIVATION_BUF_SZ
	hex "Tensor arena size"
	default 0x20000

config MODEL_IN_EXT_FLASH
	bool "Put ML model to external flash"
	select FLASH
	select ALIF_OSPI_FLASH_XIP
	help
		Initialize OSPI controller to XIP mode. Initialize the onboard flash device. Link ML model data to external flash address space.
		In addition to normal zephyr.bin output, ospi1.bin is generated. When enabled, the model memory section is set automatically (See BufAttributes.h)

config MODEL_SECTION
	string "Linker section where ML model is placed"
	depends on !MODEL_IN_EXT_FLASH
	default ".rodata.tflm_model"

config ETHOS_U_AXI0_ONLY
	bool "Only use AXI0 port on the Ethos"
	default false

config AUDIO_SAMPLES
	int "Number of audio samples to store"
	default 16000

config AUDIO_STRIDE
	int "Number of audio samples in a single stride"
	default 8000

config RESULTS_MEMORY
	int "Number of inference results to keep in memory"
	default 8

config I2S_CHANNELS
	int "Number of I2S channels"
	default 2

config I2S_SAMPLES
	int "Number of samples per slab buffer"
	default 400

config I2S_NUM_BUFFERS
	int "Number of I2S slab buffers to allocate"
	default 4

config I2S_GAIN
	int "Fixed linear again applied to I2S samples (e.g 10 = 20dB gain)"
	default 10

config I2S_THREAD_STACK_SIZE
	int "Stack size of I2S audio thread"
	default 1024

config I2S_THREAD_PRIORITY
	int "Priority of I2S audio thread"
	default 0

source "Kconfig.zephyr"
```

## subsys/bluetooth/host/Kconfig
```kconfig
# Copyright (C) 2024 Alif Semiconductor - All Rights Reserved.
# Use, distribution and modification of this code is permitted under the
# terms stated in the Alif Semiconductor Software License Agreement
#
# You should have received a copy of the Alif Semiconductor Software
# License Agreement with this file. If not, please write to:
# contact@alifsemi.com, or visit: https://alifsemi.com/license

config BLE_DEVICE_NAME
	string "Default BLE device name"
	default "ALIF"
	help
	  BLE device name

config BLE_COMPANY_ID
	hex "Default BLE Company ID"
	default "0x0CDD"
	help
	  BLE Company ID

config BLE_DEVICE_NAME_MAX
	int "Maximum device name length in bytes"
	default 28
	range 28 248
	help
	  Length of the device name string - termination character excluded

config BLE_ADV_DATA_MAX
	int "Maximum advertising data length in bytes"
	default 31
	range 31 255
	help
	  Length of the advertising data string - termination character excluded. Defaults to legacy maximum of 31 bytes.

module = BT_HOST
module-str = bt_host
source "subsys/logging/Kconfig.template.log_config"
```
