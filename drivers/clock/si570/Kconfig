## subsys/bluetooth/le_audio/Kconfig
```kconfig
#Copyright(C) 2023 Alif Semiconductor - All Rights Reserved.
#Use, distribution and modification of this code is permitted under the
#terms stated in the Alif Semiconductor Software License Agreement
#
#You should have received a copy of the Alif Semiconductor Software
#License Agreement with this file.If not, please write to:
#contact @alifsemi.com, or visit : https: // alifsemi.com/license

menuconfig ALIF_BLE_AUDIO
	bool "Alif BLE audio subsystem"
	depends on BT_CUSTOM && ALIF_ROM_LC3_CODEC
	help
	  The Alif BLE audio subsystem contains common code to be re-used across LE audio applications.

if ALIF_BLE_AUDIO

module = BLE_AUDIO
module-str = ble-audio
source "subsys/logging/Kconfig.template.log_config"

choice
	prompt "Choose BAP frame duration"
	default ALIF_BLE_AUDIO_FRAME_DURATION_10MS

	config ALIF_BLE_AUDIO_FRAME_DURATION_7_5MS
	bool "7.5ms"
	config ALIF_BLE_AUDIO_FRAME_DURATION_10MS
	bool "10ms"

endchoice

choice
	prompt "Choose audio sampling rate"
	default ALIF_BLE_AUDIO_FS_48KHZ

	config ALIF_BLE_AUDIO_FS_8KHZ
	bool "8 kHz"
	config ALIF_BLE_AUDIO_FS_16KHZ
	bool "16 kHz"
	config ALIF_BLE_AUDIO_FS_24KHZ
	bool "24 kHz"
	config ALIF_BLE_AUDIO_FS_32KHZ
	bool "32 kHz"
	config ALIF_BLE_AUDIO_FS_48KHZ
	bool "48 kHz"

endchoice

config ALIF_BLE_AUDIO_FS_HZ
	int
	range 8000 48000
	default 8000 if ALIF_BLE_AUDIO_FS_8KHZ
	default 16000 if ALIF_BLE_AUDIO_FS_16KHZ
	default 24000 if ALIF_BLE_AUDIO_FS_24KHZ
	default 32000 if ALIF_BLE_AUDIO_FS_32KHZ
	default 48000 if ALIF_BLE_AUDIO_FS_48KHZ

config ALIF_BLE_AUDIO_NMB_CHANNELS
	int "Number of audio channels"
	range 1 2
	default 2
	help
	  Number of audio channels

choice
	prompt "Choose size of each encoded audio frame in bytes"
	default ALIF_BLE_AUDIO_OCTETS_PER_CODEC_FRAME_100
	help
	  The number of bytes in each encoded audio frame. This is used to determine how much the
	  audio data needs to be compressed by the codec. For example if audio is sampled at 48 kHz,
	  each audio sample is 16 bits (2 bytes), and the frame duration is 10 ms, then the number of
	  bytes per "raw" audio frame is (48000 / 100) * 2 = 960 bytes. If the encoded audio frame is
	  100 bytes, then the data is compressed by a factor of 960 / 100 = 9.6. This choice is a
	  trade-off between audio quality and the air-time and resources used by the stream.

	config ALIF_BLE_AUDIO_OCTETS_PER_CODEC_FRAME_30
	bool "30"
	config ALIF_BLE_AUDIO_OCTETS_PER_CODEC_FRAME_40
	bool "40"
	config ALIF_BLE_AUDIO_OCTETS_PER_CODEC_FRAME_60
	bool "60"
	config ALIF_BLE_AUDIO_OCTETS_PER_CODEC_FRAME_80
	bool "80"
	config ALIF_BLE_AUDIO_OCTETS_PER_CODEC_FRAME_100
	bool "100"
	config ALIF_BLE_AUDIO_OCTETS_PER_CODEC_FRAME_120
	bool "120"
	config ALIF_BLE_AUDIO_OCTETS_PER_CODEC_FRAME_155
	bool "155"
endchoice

config ALIF_BLE_AUDIO_OCTETS_PER_CODEC_FRAME
	int
	range 30 155
	default 30 if ALIF_BLE_AUDIO_OCTETS_PER_CODEC_FRAME_30
	default 40 if ALIF_BLE_AUDIO_OCTETS_PER_CODEC_FRAME_40
	default 60 if ALIF_BLE_AUDIO_OCTETS_PER_CODEC_FRAME_60
	default 80 if ALIF_BLE_AUDIO_OCTETS_PER_CODEC_FRAME_80
	default 100 if ALIF_BLE_AUDIO_OCTETS_PER_CODEC_FRAME_100
	default 120 if ALIF_BLE_AUDIO_OCTETS_PER_CODEC_FRAME_120
	default 155 if ALIF_BLE_AUDIO_OCTETS_PER_CODEC_FRAME_155

choice
	prompt "Choose number of LE audio retransmissions"
	default ALIF_BLE_AUDIO_RTN_4
	help
	  Max number of retransmissions of each frame. A higher number will give a higher probabilty
	  of the frame being received successfully, but also uses more air-time. The controller uses
	  this value as a suggestion and may choose a different value depending on other constraints

	config ALIF_BLE_AUDIO_RTN_2
	bool "2"
	config ALIF_BLE_AUDIO_RTN_4
	bool "4"
endchoice

config ALIF_BLE_AUDIO_RTN
	int
	range 2 4
	default 2 if ALIF_BLE_AUDIO_RTN_2
	default 4 if ALIF_BLE_AUDIO_RTN_4

choice
	prompt "Choose LE audio max transport latency"
	default ALIF_BLE_AUDIO_MAX_TLATENCY_10
	help
	  The max transport latency effectively specifies the length of time during which an SDU may
	  be retransmitted. A higher value will lead to a large end-to-end audio latency, since the
	  receiver must wait for the last time slot at which the frame can be received before the
	  frame can be rendered (even if it already received an earlier transmission of the frame).
	  But a higher value also results in higher reliability due to the time diversity of frame
	  retransmissions.

	config ALIF_BLE_AUDIO_MAX_TLATENCY_10
	bool "10 ms"
	config ALIF_BLE_AUDIO_MAX_TLATENCY_20
	bool "20 ms"
endchoice

config ALIF_BLE_AUDIO_MAX_TLATENCY
	int
	default 10 if ALIF_BLE_AUDIO_MAX_TLATENCY_10
	default 20 if ALIF_BLE_AUDIO_MAX_TLATENCY_20

config AUDIO_CLOCK_DIVIDER
	int "Audio clock divider ratio"
	default 1
	help
	Clock divider ratio between the audio PLL and the I2S MCLK signal

config ALIF_BLE_AUDIO_SDU_QUEUE_LENGTH
	int "CIS or BIS stream SDU queue length"
	range 6 64
	default 12

config ALIF_BLE_AUDIO_PRESENTATION_DELAY_QUEUE_MARGIN
	int "Safety margin to be added to presentation delay"
	range 5 100
	default 20
	help
	  Safety margin extra in milliseconds.

config ALIF_BLE_AUDIO_MIN_PRESENTATION_DELAY_MS
	int "Minimum presentation delay in milliseconds"
	range 5 100
	default 30
	help
	  Minimum presentation delay in milliseconds.

config ALIF_BLE_AUDIO_SOURCE_TRANSMISSION_DELAY_ENABLED
	bool "Enable transmission delay"
	default n

config ALIF_BLE_AUDIO_SOURCE_TRANSMISSION_DELAY_MS
	depends on ALIF_BLE_AUDIO_SOURCE_TRANSMISSION_DELAY_ENABLED
	int "Use timed transmission delay in milliseconds"
	range 0 100
	default 30

config ALIF_BLE_AUDIO_USE_RAMFUNC
	bool "Run some critical functions in RAM"
	default n

rsource "Kconfig.lc3"
rsource "Kconfig.presentation_compensation"


endif # ALIF_BLE_AUDIO
```

## subsys/bluetooth/le_audio/Kconfig.lc3
```kconfig
#Copyright(C) 2025 Alif Semiconductor - All Rights Reserved.
#Use, distribution and modification of this code is permitted under the
#terms stated in the Alif Semiconductor Software License Agreement
#
#You should have received a copy of the Alif Semiconductor Software
#License Agreement with this file.If not, please write to:
#contact @alifsemi.com, or visit : https: // alifsemi.com/license

menuconfig ALIF_LC3
	bool "Alif LC3 codec"
	default y
	help
	  The Alif LC3 codec configuration contains common code to be re-used across LE audio applications.

if ALIF_LC3

module = ALIF_LC3
module-str = alif-lc3
source "subsys/logging/Kconfig.template.log_config"

config LC3_ENCODER_STACK_SIZE
	int "Stack size for LC3 encoder thread"
	default 6144
	help
	  Stack size for LC3 encoder thread. Stack requirements have been experimentally determined
	  to be around 5.5k for typical settings, so default is 6k to leave some margin.

config LC3_DECODER_STACK_SIZE
	int "Stack size for LC3 decoder thread"
	default 3072
	help
	  Stack size for LC3 decoder thread.

endif # ALIF_LC3
```

## subsys/bluetooth/le_audio/Kconfig.presentation_compensation
```kconfig
#Copyright(C) 2025 Alif Semiconductor - All Rights Reserved.
#Use, distribution and modification of this code is permitted under the
#terms stated in the Alif Semiconductor Software License Agreement
#
#You should have received a copy of the Alif Semiconductor Software
#License Agreement with this file.If not, please write to:
#contact @alifsemi.com, or visit : https: // alifsemi.com/license

menuconfig ALIF_PRESENTATION_COMPENSATION
	bool "Alif BLE audio presentation compensation"
	default y
	help
	  The Alif BLE audio presentation compensation.

if ALIF_PRESENTATION_COMPENSATION

module = ALIF_PRESENTATION_COMPENSATION
module-str = alif-presentation-compensation
source "subsys/logging/Kconfig.template.log_config"

choice
	prompt "Choose presentation compensation direction"
	help
	  The presentation compensation module need to know the direction of the stream used to determine
	  the presentation delay, as this affects which direction the audio PLL clock speed must be
	  adjusted.

	  If the presentation compensation information comes from a source stream, then a presentation
	  delay which is too long should be corrected by using a slower clock speed.

	  If the presentation compensation information comes from a aink stream, then a presentation
	  delay which is too long should be corrected by using a faster clock speed.

config PRESENTATION_COMPENSATION_DIRECTION_SOURCE
	bool "Presentation compensation input from audio source stream (host to controller)"

config PRESENTATION_COMPENSATION_DIRECTION_SINK
	bool "Presentation compensation input from audio sink stream (controller to host)"

endchoice

config PRESENTATION_COMPENSATION_PRINT_STATS
	bool "Print statistics about presentation delay"
	depends on LOG

config PRESENTATION_COMPENSATION_PRINT_STATS_INTERVAL
	int "Interval for printing presentation delay statistics, in SDU count"
	default 1024
	depends on PRESENTATION_COMPENSATION_PRINT_STATS
	help
	  Interval at which to print presentation delay statistics. The interval is measured in SDU
	  count, e.g. 1024 means to print the statistics every 512 SDUs (per channel). With a 10 ms
	  SDU interval this is around 10 seconds.

config PRESENTATION_COMPENSATION_THRESHOLD_US
	int "Presentation compensation threshold in microseconds"
	default 400
	help
	  The presentation compensation threshold is the value of presentation error above which
	  samples should be dropped or inserted. If the presentation error is below the threshold,
	  then presentation delay will be compensated by adjusting the audio clock speed instead.

config PRESENTATION_COMPENSATION_KP
	int "Presentation compensation controller proportional gain value"
	default 100
	help
	  Proportional gain used by the presentation compensation PI controller

config PRESENTATION_COMPENSATION_KI
	int "Presentation compensation controller integral gain value"
	default 30
	help
	  Integral gain used by the presentation compensation PI controller

config PRESENTATION_COMPENSATION_MAX_DELTA_F
	int "Maximum delta frequency in Hz to adjust audio clock from centre"
	default 100000
	help
	  Maximum frequency deviation in Hz that the presentation compensation module can adjust the
	  audio clock from the centre frequency. For example if the audio clock frequency is 1.536 MHz
	  and this parameter is set to 100000, the audio clock frequency will never be adjusted
	  outside the range of 1.436 - 1.636 MHz.

config PRESENTATION_COMPENSATION_MAX_INCREMENTAL_DELTA_F
	int "Maximum delta frequency in Hz to adjust audio clock in one single adjustment"
	default 100
	help
	  Maximum frequency deviation in Hz that the presentation compensation module can adjust the
	  audio clock in a single adjustment. For example if this parameter is set to 1000 and the
	  audio clock frequency is 1.536 MHz, then a single adjustment cannot adjust the clock
	  frequency outside the range of 1.535 - 1.537 MHz. Subsequent adjustments may gradually move
	  the frequency outside this range.

config PRESENTATION_COMPENSATION_CORRECTION_FACTOR
	int "Presentation compensation correction factor"
	default 16
	help
	  Correction factor which the presentation error is divided by to get the length of time which
	  should be compensated by dropping or adding audio samples. For example if the presentation
	  error is 500 us and the correction factor is 5, then 100 us worth of samples will be dropped
	  or inserted. This is important in the case where there is a delay between dropping/inserting
	  samples and this actually taking effect on the measured presentation delay. For example if
	  the presentation error is 500 us but dropping samples will not take effect until 4 SDUs
	  later (since the SDUs must pass through encoding and buffering first), then if we did *not*
	  have this correction factor we would apply a 500 us correction on four SDUs rather than
	  just one, until the effect of dropping/inserting samples can be seen. This would cause an
	  over-correction which would then have to be corrected back in the other direction. Using a
	  correction factor greater than 1 causes any presentation error to be removed gradually over
	  several SDUs rather than all in one go.

config PRESENTATION_COMPENSATION_DEBUG
	bool "Enable debug data to be recorded by presentation compensation module"
	depends on LOG
	help
		The PI controller coefficients of the presentation compensation module may need tuning for
		some use-cases. Enabling this causes presentation compensation data to be logged into a
		buffer for later analysis. When the buffer is full, a callback can be triggered to notify
		the application.

if PRESENTATION_COMPENSATION_DEBUG

config PRESENTATION_COMPENSATION_DEBUG_SAMPLES
	int "Number of data points to log for presentation compensation debug"
	default 1000

endif # PRESENTATION_COMPENSATION_DEBUG
endif # ALIF_PRESENTATION_COMPENSATION
```
